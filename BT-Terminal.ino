//Made by:  (c)  Thunderbolt1003USA
//Github Profile:https://github.com/thunderbolt1003usa
//Github Repo:   https://github.com/thunderbolt1003usa/BT-Terminal
//Homepage:      https://thunderbolt1003usa.github.io
//
// You are allowed to use ,copy ,modify or distribute this code 
// but you're not allowed to sell this code(make money) ,patent it or do illegal things with it.

#include <Wire.h>
#include <Adafruit_GFX.h>
#include <Adafruit_SSD1306.h>

#define SCREEN_WIDTH 128
#define SCREEN_HEIGHT 64
#define OLED_RESET    -1

Adafruit_SSD1306 display(SCREEN_WIDTH, SCREEN_HEIGHT, &Wire, OLED_RESET);

String buffer = "";

// 'bitmap', 128x64px
const unsigned char thunderbolt1003usabitmap [] PROGMEM = {
	0xff, 0xff, 0xff, 0xff, 0xff, 0xff, 0xff, 0xff, 0xff, 0xff, 0xff, 0xff, 0xff, 0xff, 0xff, 0xff, 
	0xff, 0xff, 0xff, 0xff, 0xff, 0xff, 0xf0, 0x00, 0x00, 0x1f, 0xff, 0xff, 0xff, 0xff, 0xff, 0xff, 
	0xff, 0xff, 0xff, 0xff, 0xff, 0xf0, 0x0f, 0xff, 0xff, 0xe0, 0x1f, 0xff, 0xff, 0xff, 0xff, 0xff, 
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	0xff, 0xff, 0xff, 0xff, 0xff, 0xff, 0xff, 0xff, 0xff, 0xff, 0xff, 0xff, 0xff, 0xff, 0xff, 0xff
};

// Array of all bitmaps for convenience. (Total bytes used to store images in PROGMEM = 1040)
const int thunderbolt1003usaallArray_LEN = 1;
const unsigned char* thunderbolt1003usaallArray[1] = {
	thunderbolt1003usabitmap
};

// ⏳ Timeout-Tracking
unsigned long lastActivityTime = millis(); // Zeitpunkt der letzten Aktivität
const unsigned long timeoutDuration = 30000; // 10 Sekunden

int ballX = random(0, 125);
int ballY = random(0, 61);
int dx = 1;
int dy = 1;

const unsigned char starBitmap[] PROGMEM = {
  0x10, //    █
  0x54, //  █ █ █
  0x38, //   ███
  0x7C, //  █████
  0x38, //   ███
  0x54, //  █ █ █
  0x10, //    █
  0x00  
};

void setup() {
  // OLED initialisieren
  if (!display.begin(SSD1306_SWITCHCAPVCC, 0x3C)) {
    while (true) { /* bleibt hier hängen, falls kein Display */ }
  }

  display.clearDisplay();
  display.drawBitmap(0, 0, thunderbolt1003usabitmap, 128, 64, SSD1306_WHITE); // Bitmap anzeigen
  display.display();
  delay(5000); // Anzeige für 2 Sekunden

  display.clearDisplay();
  display.setTextSize(1);
  display.setTextColor(SSD1306_WHITE);
  display.setCursor(0, 0);
  display.println("_");
  display.display();

  // Hardware-Serial (Bluetooth) starten
  Serial.begin(9600);
}

void loop() {
	bool activity = false;
  // Empfange Zeichen über HC-05
  while (Serial.available()) {
    activity = true;
    byte c = Serial.read();

    if (c >= 1 && c <= 5) {
      display.setTextSize(c); // Rest überspringen
      display.clearDisplay();       // Anzeige löschen
      display.setCursor(0, 0);      // Cursor zurücksetzen
      display.println(buffer);      // Aktuellen Text nochmal anzeigen
      display.display();            // Display aktualisieren
    return;

    }

    else if (c == '\n') {
      // Vollständige Zeile angekommen → Display aktualisieren
      display.clearDisplay();
      display.setCursor(0, 0);
      display.println(buffer);
      display.display();
      buffer = "";
    }
    else {
      buffer += (char)c;
    }
  }
	if (activity) {
    lastActivityTime = millis();
  }
  // Prüfe auf Inaktivität
  if (millis() - lastActivityTime > timeoutDuration) {

		ballX += dx;
    ballY += dy;

		// Rand-Kollision
  if (ballX <= 0 || ballX >= 125) dx *= -1;
  if (ballY <= 0 || ballY >= 61) dy *= -1;

    display.clearDisplay();
    display.drawBitmap(0, 0, thunderbolt1003usabitmap, 128, 64, SSD1306_WHITE);
		// Ball drüberzeichnen
    display.drawBitmap(ballX, ballY, starBitmap, 8, 8, SSD1306_BLACK);
    display.display();
		delay(20);

    //lastActivityTime = millis(); // damit Bitmap nicht ständig neu gezeichnet wird
  }
}
